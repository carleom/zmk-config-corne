#define CONFIG_WIRELESS
#define ZMK_BASE_LAYER(name, LT, RT, LM, RM, LB, RB, LH, RH)                   \
    ZMK_LAYER(                                                                 \
        name,                                                                  \
        &kp ESC LT RT &kp BSPC                                                  \
        &kp TAB LM RM &kp RET                                                   \
        &kp LGUI LB RB &kp RCTRL                                                \
        &kp LGUI LH RH &smart_mouse                                             \
    )

#include "zmk-helpers/key-labels/42.h"
#include "base.keymap"

/{ chosen { zmk,physical-layout = &foostan_corne_6col_layout; }; };
